// =============================================================================
// pypilot_proto.cpp — CRC-8, packet builder, telemetry sniffer
// =============================================================================
#include "pypilot_proto.h"
#include <Arduino.h>

ProtocolSniffer protoSniffer;   // global singleton

// ---------------------------------------------------------------------------
// CRC-8  (init 0xFF)
// Table and algorithm copied directly from pypilot arduino_servo.cpp
// ---------------------------------------------------------------------------
static const uint8_t crc8Table[256] PROGMEM = {
    0x00, 0x31, 0x62, 0x53, 0xC4, 0xF5, 0xA6, 0x97,
    0xB9, 0x88, 0xDB, 0xEA, 0x7D, 0x4C, 0x1F, 0x2E,
    0x43, 0x72, 0x21, 0x10, 0x87, 0xB6, 0xE5, 0xD4,
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    0x3B, 0x0A, 0x59, 0x68, 0xFF, 0xCE, 0x9D, 0xAC,
};

uint8_t ppCrc8(const uint8_t* data, size_t len) {
    uint8_t crc = 0xFF;   // init value 0xFF — matches pypilot arduino_servo.cpp
    for (size_t i = 0; i < len; i++) {
        crc = pgm_read_byte(&crc8Table[crc ^ data[i]]);
    }
    return crc;
}

// ---------------------------------------------------------------------------
// Build a 4-byte command packet:  [code, val_lo, val_hi, crc]
// ---------------------------------------------------------------------------
size_t ppBuildPacket(uint8_t code, uint16_t value, uint8_t* out) {
    out[0] = code;
    out[1] = value & 0xFF;
    out[2] = (value >> 8) & 0xFF;
    out[3] = ppCrc8(out, 3);
    return 4;
}

// ---------------------------------------------------------------------------
// ProtocolSniffer — feed raw bytes, decode telemetry
// ---------------------------------------------------------------------------

void ProtocolSniffer::decode(uint8_t code, uint16_t val) {
    _telem.lastUpdateMs = millis();
    _telem.packetCount++;

    switch (code) {
        case PP_CURRENT_CODE:
            _telem.current_A = val * 0.01f;          // 10 mA units → A
            break;
        case PP_VOLTAGE_CODE:
            _telem.voltage_V = val * 0.01f;          // 10 mV units → V
            break;
        case PP_CONTROLLER_TEMP_CODE:
            _telem.controllerTemp_C = val * 0.01f;   // hundredths °C
            break;
        case PP_MOTOR_TEMP_CODE:
            _telem.motorTemp_C = val * 0.01f;
            break;
        case PP_RUDDER_SENSE_CODE:
            _telem.rudderRaw = val;
            break;
        case PP_FLAGS_CODE:
            _telem.flags = val;
            break;
        default:
            break;   // unknown code — ignore
    }
}

bool ProtocolSniffer::feedByte(uint8_t b) {
    _buf[_pos++] = b;

    if (_pos < 4) return false;        // need 4 bytes

    // Check CRC of bytes 0-2 against byte 3
    uint8_t expected = ppCrc8(_buf, 3);
    if (_buf[3] == expected) {
        _syncRun++;
        if (_syncRun >= 2) _synced = true;

        if (_synced) {
            uint16_t val = _buf[1] | ((uint16_t)_buf[2] << 8);
            decode(_buf[0], val);
            _pos = 0;
            return true;
        }
        // First good CRC — might be coincidence, wait for second
        _pos = 0;
        return false;
    }

    // CRC mismatch — shift buffer by 1 byte and try again
    _telem.errorCount++;
    _syncRun = 0;
    _synced  = false;
    _buf[0] = _buf[1];
    _buf[1] = _buf[2];
    _buf[2] = _buf[3];
    _pos = 3;
    return false;
}
